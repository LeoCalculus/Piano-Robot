#include <oled1315.h>

// 5x7 ASCII font (characters 32-126)
const uint8_t OLED_Font5x7[][5] = {
    {0x00, 0x00, 0x00, 0x00, 0x00}, // Space
    {0x00, 0x00, 0x5F, 0x00, 0x00}, // !
    {0x00, 0x07, 0x00, 0x07, 0x00}, // "
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    {0x08, 0x08, 0x2A, 0x1C, 0x08}, // ~
};

void OLED_WriteCommand(uint8_t cmd) {
    // set a command buffer used to send data
    uint8_t command[2] = {0x00, cmd}; 
    HAL_I2C_Master_Transmit(&hi2c1, SSD1315_ADDR, command, 2, 10);
}

void OLED_WriteData(uint8_t data) {
    // same as command:
    uint8_t writeData[2] = {0x40, data}; // the control have to be 0x40
    HAL_I2C_Master_Transmit(&hi2c1, SSD1315_ADDR, writeData, 2, 10);
}

void OLED_Init(void) {
    // wait for OLED to powerup
    HAL_Delay(100);
    // Do not display on set up time
    OLED_WriteCommand(0xAE);
    // display geometry setup
    OLED_WriteCommand(0xA8);
    OLED_WriteCommand(0x3F);
    // display offset
    OLED_WriteCommand(0xD3);
    OLED_WriteCommand(0x00);
    // start line = 0
    OLED_WriteCommand(0x40);
    // enable dc-dc pump 
    OLED_WriteCommand(0x8D);
    OLED_WriteCommand(0x14);
    // write horizontally 
    OLED_WriteCommand(0x20);
    OLED_WriteCommand(0x00);
    // orientation -> depend on the direction of OLED
    // here rotate 180 deg
    OLED_WriteCommand(0xA1);
    OLED_WriteCommand(0xC8);
    // 128 * 64 display mode
    OLED_WriteCommand(0xDA);
    OLED_WriteCommand(0x12);
    // display with brighter pixels
    OLED_WriteCommand(0x81);
    OLED_WriteCommand(0xCF);
    // display depend on RAM, normal display
    OLED_WriteCommand(0xA4);
    OLED_WriteCommand(0xA6);
    // clear content avoid random stuff
    OLED_Clear();
    // enable the final display
    OLED_WriteCommand(0xAF);

}

// a page is 8 verticle pixel (a letter size)
void OLED_SetCursor(uint8_t x, uint8_t page) {
    // set page location 
    OLED_WriteCommand(0xB0 + page);
    // column location, into lower address and high address
    // low address
    OLED_WriteCommand(0x00 + (x & 0x0F));
    // high address
    OLED_WriteCommand(0x10 + (x >> 4));
}

void OLED_Clear(void) {
    for (uint8_t page = 0; page < OLED_PAGES; page++) {
        OLED_SetCursor(0, page);
        for (uint8_t x = 0; x < OLED_WIDTH; x++) {
            OLED_WriteData(0x00);
        }
    }
    OLED_SetCursor(0, 0);
}

void OLED_WriteChar(char c) {
    if (c < 32 || c > 126) c = ' '; // check with ASCII if not in range just replace with empty
    for (uint8_t i = 0; i < 5; i++) {
        OLED_WriteData(OLED_Font5x7[c - 32][i]); // map ASCII to given font table
    }
    OLED_WriteData(0x00); // 1 pixel spacing between chars
}

void OLED_WriteString(const char *str) {
    while (*str) {
        OLED_WriteChar(*str++);
    }
}

void OLED_SetContrast(uint8_t contrast) {
    OLED_WriteCommand(0x81);
    OLED_WriteCommand(contrast);
}
